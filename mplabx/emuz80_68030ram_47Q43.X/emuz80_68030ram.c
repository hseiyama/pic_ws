/*!
 * PIC18F47Q43/PIC18F47Q83/PIC18F47Q84 ROM image uploader and UART emulation firmware
 * This single source file contains all code
 *
 * Target: EMUZ80 with 68030+RAM
 * Compiler: MPLAB XC8 v2.40
 *
 * Modified by Satoshi Okue https://twitter.com/S_Okue
 * Version 0.1 2023/2/28
 * Version 0.2 2023/4/19
 */

/*
	PIC18F47Q43 ROM RAM and UART emulation firmware
	This single source file contains all code

	Target: EMUZ80 - The computer with only Z80 and PIC18F47Q43
	Compiler: MPLAB XC8 v2.36
	Written by Tetsuya Suzuki
*/

// CONFIG1
#pragma config FEXTOSC = OFF	// External Oscillator Selection (Oscillator not enabled)
#pragma config RSTOSC = HFINTOSC_64MHZ// Reset Oscillator Selection (HFINTOSC with HFFRQ = 64 MHz and CDIV = 1:1)

// CONFIG2
#pragma config CLKOUTEN = OFF	// Clock out Enable bit (CLKOUT function is disabled)
#pragma config PR1WAY = ON		// PRLOCKED One-Way Set Enable bit (PRLOCKED bit can be cleared and set only once)
#pragma config CSWEN = ON		// Clock Switch Enable bit (Writing to NOSC and NDIV is allowed)
#pragma config FCMEN = ON		// Fail-Safe Clock Monitor Enable bit (Fail-Safe Clock Monitor enabled)
#ifndef _18F47Q43
#pragma config JTAGEN = OFF		// JTAG Enable bit (Disable JTAG Boundary Scan mode, JTAG pins revert to user functions)
#pragma config FCMENP = OFF		// Fail-Safe Clock Monitor -Primary XTAL Enable bit (FSCM timer will set FSCMP bit and OSFIF interrupt on Primary XTAL failure)
#pragma config FCMENS = OFF		// Fail-Safe Clock Monitor -Secondary XTAL Enable bit (FSCM timer will set FSCMS bit and OSFIF interrupt on Secondary XTAL failure)
#endif

// CONFIG3
#pragma config MCLRE = EXTMCLR	// MCLR Enable bit (If LVP = 0, MCLR pin is MCLR; If LVP = 1, RE3 pin function is MCLR )
#pragma config PWRTS = PWRT_OFF	// Power-up timer selection bits (PWRT is disabled)
#pragma config MVECEN = ON		// Multi-vector enable bit (Multi-vector enabled, Vector table used for interrupts)
#pragma config IVT1WAY = ON		// IVTLOCK bit One-way set enable bit (IVTLOCKED bit can be cleared and set only once)
#pragma config LPBOREN = OFF	// Low Power BOR Enable bit (Low-Power BOR disabled)
#pragma config BOREN = SBORDIS	// Brown-out Reset Enable bits (Brown-out Reset enabled , SBOREN bit is ignored)

// CONFIG4
#pragma config BORV = VBOR_1P9	// Brown-out Reset Voltage Selection bits (Brown-out Reset Voltage (VBOR) set to 1.9V)
#pragma config ZCD = OFF		// ZCD Disable bit (ZCD module is disabled. ZCD can be enabled by setting the ZCDSEN bit of ZCDCON)
#pragma config PPS1WAY = OFF	// PPSLOCK bit One-Way Set Enable bit (PPSLOCKED bit can be set and cleared repeatedly (subject to the unlock sequence))
#pragma config STVREN = ON		// Stack Full/Underflow Reset Enable bit (Stack full/underflow will cause Reset)
#pragma config LVP = ON			// Low Voltage Programming Enable bit (Low voltage programming enabled. MCLR/VPP pin function is MCLR. MCLRE configuration bit is ignored)
#pragma config XINST = OFF		// Extended Instruction Set Enable bit (Extended Instruction Set and Indexed Addressing Mode disabled)

// CONFIG5
#pragma config WDTCPS = WDTCPS_31// WDT Period selection bits (Divider ratio 1:65536; software control of WDTPS)
#pragma config WDTE = OFF		// WDT operating mode (WDT Disabled; SWDTEN is ignored)

// CONFIG6
#pragma config WDTCWS = WDTCWS_7// WDT Window Select bits (window always open (100%); software control; keyed access not required)
#pragma config WDTCCS = SC		// WDT input clock selector (Software Control)

// CONFIG7
#pragma config BBSIZE = BBSIZE_512// Boot Block Size selection bits (Boot Block size is 512 words)
#pragma config BBEN = OFF		// Boot Block enable bit (Boot block disabled)
#pragma config SAFEN = OFF		// Storage Area Flash enable bit (SAF disabled)
#pragma config DEBUG = OFF		// Background Debugger (Background Debugger disabled)

// CONFIG8
#pragma config WRTB = OFF		// Boot Block Write Protection bit (Boot Block not Write protected)
#pragma config WRTC = OFF		// Configuration Register Write Protection bit (Configuration registers not Write protected)
#pragma config WRTD = OFF		// Data EEPROM Write Protection bit (Data EEPROM not Write protected)
#pragma config WRTSAF = OFF		// SAF Write protection bit (SAF not Write Protected)
#pragma config WRTAPP = OFF		// Application Block write protection bit (Application Block not write protected)

#ifndef _18F47Q43
// CONFIG9
#pragma config BOOTPINSEL = RC5	// CRC on boot output pin selection (CRC on boot output pin is RC5)
#pragma config BPEN = OFF		// CRC on boot output pin enable bit (CRC on boot output pin disabled)
#pragma config ODCON = OFF		// CRC on boot output pin open drain bit (Pin drives both high-going and low-going signals)
#endif

// CONFIG10
#pragma config CP = OFF			// PFM and Data EEPROM Code Protection bit (PFM and Data EEPROM code protection disabled)

#ifndef _18F47Q43
// CONFIG11
#pragma config BOOTSCEN = OFF	// CRC on boot scan enable for boot area (CRC on boot will not include the boot area of program memory in its calculation)
#pragma config BOOTCOE = HALT	// CRC on boot Continue on Error for boot areas bit (CRC on boot will stop device if error is detected in boot areas)
#pragma config APPSCEN = OFF	// CRC on boot application code scan enable (CRC on boot will not include the application area of program memory in its calculation)
#pragma config SAFSCEN = OFF	// CRC on boot SAF area scan enable (CRC on boot will not include the SAF area of program memory in its calculation)
#pragma config DATASCEN = OFF	// CRC on boot Data EEPROM scan enable (CRC on boot will not include data EEPROM in its calculation)
#pragma config CFGSCEN = OFF	// CRC on boot Config fuses scan enable (CRC on boot will not include the configuration fuses in its calculation)
#pragma config COE = HALT		// CRC on boot Continue on Error for non-boot areas bit (CRC on boot will stop device if error is detected in non-boot areas)
#pragma config BOOTPOR = OFF	// Boot on CRC Enable bit (CRC on boot will not run)

// CONFIG12
#pragma config BCRCPOLT = hFF	// Boot Sector Polynomial for CRC on boot bits 31-24 (Bits 31:24 of BCRCPOL are 0xFF)

// CONFIG13
#pragma config BCRCPOLU = hFF	// Boot Sector Polynomial for CRC on boot bits 23-16 (Bits 23:16 of BCRCPOL are 0xFF)

// CONFIG14
#pragma config BCRCPOLH = hFF	// Boot Sector Polynomial for CRC on boot bits 15-8 (Bits 15:8 of BCRCPOL are 0xFF)

// CONFIG15
#pragma config BCRCPOLL = hFF	// Boot Sector Polynomial for CRC on boot bits 7-0 (Bits 7:0 of BCRCPOL are 0xFF)

// CONFIG16
#pragma config BCRCSEEDT = hFF	// Boot Sector Seed for CRC on boot bits 31-24 (Bits 31:24 of BCRCSEED are 0xFF)

// CONFIG17
#pragma config BCRCSEEDU = hFF	// Boot Sector Seed for CRC on boot bits 23-16 (Bits 23:16 of BCRCSEED are 0xFF)

// CONFIG18
#pragma config BCRCSEEDH = hFF	// Boot Sector Seed for CRC on boot bits 15-8 (Bits 15:8 of BCRCSEED are 0xFF)

// CONFIG19
#pragma config BCRCSEEDL = hFF	// Boot Sector Seed for CRC on boot bits 7-0 (Bits 7:0 of BCRCSEED are 0xFF)

// CONFIG20
#pragma config BCRCEREST = hFF	// Boot Sector Expected Result for CRC on boot bits 31-24 (Bits 31:24 of BCRCERES are 0xFF)

// CONFIG21
#pragma config BCRCERESU = hFF	// Boot Sector Expected Result for CRC on boot bits 23-16 (Bits 23:16 of BCRCERES are 0xFF)

// CONFIG22
#pragma config BCRCERESH = hFF	// Boot Sector Expected Result for CRC on boot bits 15-8 (Bits 15:8 of BCRCERES are 0xFF)

// CONFIG23
#pragma config BCRCERESL = hFF	// Boot Sector Expected Result for CRC on boot bits 7-0 (Bits 7:0 of BCRCERES are 0xFF)

// CONFIG24
#pragma config CRCPOLT = hFF	// Non-Boot Sector Polynomial for CRC on boot bits 31-24 (Bits 31:24 of CRCPOL are 0xFF)

// CONFIG25
#pragma config CRCPOLU = hFF	// Non-Boot Sector Polynomial for CRC on boot bits 23-16 (Bits 23:16 of CRCPOL are 0xFF)

// CONFIG26
#pragma config CRCPOLH = hFF	// Non-Boot Sector Polynomial for CRC on boot bits 15-8 (Bits 15:8 of CRCPOL are 0xFF)

// CONFIG27
#pragma config CRCPOLL = hFF	// Non-Boot Sector Polynomial for CRC on boot bits 7-0 (Bits 7:0 of CRCPOL are 0xFF)

// CONFIG28
#pragma config CRCSEEDT = hFF	// Non-Boot Sector Seed for CRC on boot bits 31-24 (Bits 31:24 of CRCSEED are 0xFF)

// CONFIG29
#pragma config CRCSEEDU = hFF	// Non-Boot Sector Seed for CRC on boot bits 23-16 (Bits 23:16 of CRCSEED are 0xFF)

// CONFIG30
#pragma config CRCSEEDH = hFF	// Non-Boot Sector Seed for CRC on boot bits 15-8 (Bits 15:8 of CRCSEED are 0xFF)

// CONFIG31
#pragma config CRCSEEDL = hFF	// Non-Boot Sector Seed for CRC on boot bits 7-0 (Bits 7:0 of CRCSEED are 0xFF)

// CONFIG32
#pragma config CRCEREST = hFF	// Non-Boot Sector Expected Result for CRC on boot bits 31-24 (Bits 31:24 of CRCERES are 0xFF)

// CONFIG33
#pragma config CRCERESU = hFF	// Non-Boot Sector Expected Result for CRC on boot bits 23-16 (Bits 23:16 of CRCERES are 0xFF)

// CONFIG34
#pragma config CRCERESH = hFF	// Non-Boot Sector Expected Result for CRC on boot bits 15-8 (Bits 15:8 of CRCERES are 0xFF)

// CONFIG35
#pragma config CRCERESL = hFF	// Non-Boot Sector Expected Result for CRC on boot bits 7-0 (Bits 7:0 of CRCERES are 0xFF)
#endif

// #pragma config statements should precede project file includes.
// Use project enums instead of #define for ON and OFF.

#include <xc.h>
#include <stdio.h>

#define ASMBL

#define CLK_68030 10000000UL	// 68030 clock frequency(Max 16MHz)

#define ROM_SIZE 0x8000		// 16K bytes Max. 32K bytes

#define UART_DREG 0x8000	//Data REG :A30,A14-A0 1xxx_xxxx_x000_0000b
#define UART_CREG 0x8001	//Control REG :A30,A14-A0 1xxx_xxxx_x000_0001b

#define _XTAL_FREQ 64000000UL

//68030 ROM equivalent, see end of this file
extern const unsigned char rom[];

/////////////////////////////////////////////////////////////
// UART ring buffer for XON/XOFF
#define XON  0x11		// code DC1
#define XOFF 0x13		// code DC3
#define U3TB_SIZE 128
#define U3RB_SIZE 128

volatile unsigned char tx_buf[U3TB_SIZE];	//UART Tx ring buffer
volatile unsigned char rx_buf[U3RB_SIZE];	//UART Rx ring buffer
volatile unsigned char rx_xflg, rx_xreq;
volatile unsigned int rx_wp, rx_rp, rx_cnt;
volatile unsigned int tx_wp, tx_rp, tx_cnt;
/////////////////////////////////////////////////////////////

//Address Bus
union {
	unsigned int w; //16 bits Address
	struct {
		unsigned char l; //Address low
		unsigned char h; //Address high
	};
} ab;


// UART3 Transmit
void putch(char c) {
	while(!U3TXIF); // Wait or Tx interrupt flag set
	U3TXB = c; // Write data
}

/*
// UART3 Recive
char getch(void) {
	while(!U3RXIF); // Wait for Rx interrupt flag set
	return U3RXB; // Read data
}
*/

// Never called, logically
void __interrupt(irq(default),base(8)) Default_ISR(){}

////////////// UART3 Transmit interrupt /////////////////////////
//UART3 Tx interrupt
/////////////////////////////////////////////////////////////////
void __interrupt(irq(U3TX),base(8)) URT3Tx_ISR(){

	if (rx_xreq) {
		U3TXB = rx_xreq;
		rx_xreq = 0;
		if (!tx_cnt) U3TXIE = 0;		// disable Tx interrupt
	}
	else {
		if (!tx_cnt) U3TXIE = 0;		// disable Tx interrupt
		else {
			U3TXB = tx_buf[tx_rp];
			tx_rp = (tx_rp + 1) & (U3TB_SIZE - 1);
			tx_cnt--;
		}
	}
}

////////////// UART3 Receive interrupt //////////////////////////
//UART3 Rx interrupt
/////////////////////////////////////////////////////////////////
void __interrupt(irq(U3RX),base(8)) URT3Rx_ISR(){

	unsigned char rx_data;

	rx_data = U3RXB;			// get rx data
	if (rx_cnt < U3RB_SIZE) {
		rx_buf[rx_wp] = rx_data;
		rx_wp = (rx_wp + 1) & (U3RB_SIZE - 1);
		rx_cnt++;
		if ((rx_xflg == XON) && (rx_cnt == U3RB_SIZE - 64)) {
			rx_xreq = rx_xflg = XOFF;
			U3TXIE = 1;
		}
	}
}

// main routine
void main(void) {

	unsigned int i;

	// System initialize
	OSCFRQ = 0x08;		// 64MHz internal OSC

	// RESET (RE2) output pin
	ANSELE2 = 0;		// Disable analog function
	LATE2 = 0;			// Reset=Low
	TRISE2 = 0;			// Set as output

	// BR (RE1) output pin
	ANSELE1 = 0;		// Disable analog function
	LATE1 = 0;			// BR=Low
	TRISE1 = 0;			// Set as output

	// Address bus A30,A14-A8 pin
	ANSELD = 0x00;		// Disable analog function
	LATD = 0x00;
	TRISD = 0x00;		// Set as output

	// Address bus A7-A0 pin
	ANSELB = 0x00;		// Disable analog function
	LATB = 0x00;
	TRISB = 0x00;		// Set as output

	// Data bus D7-D0 pin
	ANSELC = 0x00;		// Disable analog function
	LATC = 0x00;
	TRISC = 0x00;		// Set as output

	// 68030 clock(RA2) by NCO FDC mode
	RA2PPS = 0x3f;		// RA2 assign NCO1
	ANSELA2 = 0;		// Disable analog function
	TRISA2 = 0;			// NCO output pin
	NCO1INC = (unsigned int)(CLK_68030 / 30.5175781);
	NCO1CLK = 0x00;		// Clock source Fosc
	NCO1PFM = 0;		// FDC mode
	NCO1OUT = 1;		// NCO output enable
	NCO1EN = 1;		// NCO enable

	// AS (RA0) input pin
	ANSELA0 = 0;		// Disable analog function
	WPUA0 = 1;			// Week pull up
	TRISA0 = 1;			// Set as intput

	// R/W (RA5) input pin
	ANSELA5 = 0;		// Disable analog function
	WPUA5 = 1;			// Week pull up
	TRISA5 = 1;			// Set as intput

	// DSACK0 (RA4) output pin
	ANSELA4 = 0;		// Disable analog function
//	RA4PPS = 0x00;		// LATA4 -> RA4
	LATA4 = 0;			// DTACK=High
	TRISA4 = 0;			// Set as output

	// BERR (RE0) output pin
	ANSELE0 = 0;		// Disable analog function
	LATE0 = 1;			// BERR=High
	TRISE0= 0;			// Set as output

	// /WE (RA1) output pin
	ANSELA1 = 0;		// Disable analog function
	RA1PPS = 0x00;		// LATA1 -> RA1
	LATA1 = 1;			// /WE = High
	TRISA1 = 0;			// Set as output

	// /OE (RA3) output pin
	ANSELA3 = 0;		// Disable analog function
	RA3PPS = 0x00;		// LATA3 -> RA3
	LATA3 = 1;			// /OE = Low
	TRISA3 = 0;			// Set as output

	// UART3 initialize
//	U3BRG = 416;		// 9600bps @ 64MHz
//	U3BRG = 208;		// 19200bps @ 64MHz
//	U3BRG = 104;		// 38400bps @ 64MHz
	U3BRG = 34;			// 115200bps @ 64MHz
	U3CON2 = 0x81;		// RUNOVF=1: the XON and XOFF characters continue to be
						//           received and processed without the need to clear
						//           the input FIFO by reading UxRXB.
						// FLO = 01: XON/XOFF Software flow control

	// UART ring buffer init
	rx_xreq = 0;
	rx_xflg = XON;
	rx_wp = rx_rp = rx_cnt = 0;
	tx_wp = tx_rp = tx_cnt = 0;

	U3RXEN = 1;			// Receiver enable
	U3TXEN = 1;			// Transmitter enable

	// UART3 Receiver
	ANSELA7 = 0;		// Disable analog function
	TRISA7 = 1;			// RX set as input
	U3RXPPS = 0x07;		// RA7->UART3:RX3;

	// UART3 Transmitter
	ANSELA6 = 0;		// Disable analog function
	LATA6 = 1;			// Default level
	TRISA6 = 0;			// TX set as output
	RA6PPS = 0x26;		// RA6->UART3:TX3;

	U3ON = 1;			// Serial port enable

	for(i = 0; i < ROM_SIZE; i++) {
		ab.w = i;
		LATD = ab.h;
		LATB = ab.l;
		LATA1 = 0;		// /WE=0
		LATC = rom[i];
		LATA1 = 1;		// /WE=1
	}

	// Address bus A30,A14-A8 pin
	ANSELD = 0x00;		// Disable analog function
	WPUD = 0xff;		// Week pull up
	TRISD = 0xff;		// Set as input

	// Address bus AD7-AD0 pin
	ANSELB = 0x00;		// Disable analog function
	WPUB = 0xff;		// Week pull up
	TRISB = 0xff;		// Set as input

	// Data bus D7-D0 pin
	ANSELC = 0x00;		// Disable analog function
	WPUC = 0xff;		// Week pull up
	TRISC = 0xff;		// Set as input(default)

	printf("\r\nMEZ68030RAM %2.3fMHz\r\n",NCO1INC * 30.5175781 / 1000000);

	//========== CLC pin assign ===========
	CLCIN0PPS = 0x00;	// RA0 <- AS
	CLCIN1PPS = 0x05;	// RA5 <- RW
	CLCIN2PPS = 0x1f;	// RD7 <- A30

	//========== CLC1 /OE ==========
	CLCSELECT = 0;		// CLC1 select
	CLCnCON = 0x00;		// Disable CLC

	CLCnSEL0 = 0;		// CLCIN0PPS <- AS
	CLCnSEL1 = 1;		// CLCIN1PPS <- RW
	CLCnSEL2 = 2;		// CLCIN2PPS <- A30
	CLCnSEL3 = 127;		// NC

	CLCnGLS0 = 0x01;	// AS inverted
	CLCnGLS1 = 0x08;	// R_W noninverted
	CLCnGLS2 = 0x10;	// A30 inverted
	CLCnGLS3 = 0x40;	// 1(0 inverted) for AND gate

	CLCnPOL = 0x80;		// inverted the CLC1 output
	CLCnCON = 0x82;		// 4 input AND

	//========== CLC2 /WE ==========
	CLCSELECT = 1;		// CLC2 select
	CLCnCON = 0x00;		// Disable CLC

	CLCnSEL0 = 0;		// CLCIN0PPS <- AS
	CLCnSEL1 = 1;		// CLCIN1PPS <- RW
	CLCnSEL2 = 2;		// CLCIN2PPS <- A30
	CLCnSEL3 = 127;		// NC

	CLCnGLS0 = 0x01;	// AS inverted
	CLCnGLS1 = 0x04;	// R_W inverted
	CLCnGLS2 = 0x10;	// A30 inverted
	CLCnGLS3 = 0x40;	// 1(0 inverted) for AND gate

	CLCnPOL = 0x80;		// inverted the CLC2 output
	CLCnCON = 0x82;		// 4 input AND

	//========== CLC3 /IORQ :IO area 0x40000000 - 0x7FFFFFFF ==========
	//                               0xC0000000 - 0xFFFFFFFF
	CLCSELECT = 2;		// CLC3 select
	CLCnCON = 0x00;		// Disable CLC

	CLCnSEL0 = 0;		// CLCIN0PPS <- AS
	CLCnSEL1 = 2;		// CLCIN2PPS <- A30
	CLCnSEL2 = 127;		// NC
	CLCnSEL3 = 127;		// NC

	CLCnGLS0 = 0x01;	// AS inverted
	CLCnGLS1 = 0x08;	// A30 noninverted
	CLCnGLS2 = 0x10;	// 1(0 inverted) for AND gate
	CLCnGLS3 = 0x40;	// 1(0 inverted) for AND gate

	CLCnPOL = 0x80;		// inverted the CLC3 output
	CLCnCON = 0x82;		// 4 input AND

	//========== CLC5 DSACK0 ==========
	CLCSELECT = 4;		// CLC5 select
	CLCnCON = 0x00;		// Disable CLC

	CLCnSEL0 = 53;		// D-FF CLK <- CLC3 /IORQ
	CLCnSEL1 = 127;		// D-FF D NC
	CLCnSEL2 = 127;		// D-FF S NC
	CLCnSEL3 = 127;		// D-FF R NC

	CLCnGLS0 = 0x1;		// LCG1D1N
	CLCnGLS1 = 0x0;		// Connect none
	CLCnGLS2 = 0x0;		// Connect none
	CLCnGLS3 = 0x0;		// Connect none

	CLCnPOL = 0x02;		// noninverted the CLC5 output, G2 inverted
	CLCnCON = 0x84;		// Select D-FF

	//========== CLC output pin assign ===========
	// 1,2,5,6 = Port A, C
	// 3,4,7,8 = Port B, D
	RA3PPS = 0x01;		// CLC1OUT -> RA3 -> /OE
	RA1PPS = 0x02;		// CLC2OUT -> RA1 -> /WE
	RA4PPS = 0x05;		// CLC5OUT -> RA4 -> DSACK0

	// Unlock IVT
	IVTLOCK = 0x55;
	IVTLOCK = 0xAA;
	IVTLOCKbits.IVTLOCKED = 0x00;

	// Default IVT base address
	IVTBASE = 0x000008;

	// Lock IVT
	IVTLOCK = 0x55;
	IVTLOCK = 0xAA;
	IVTLOCKbits.IVTLOCKED = 0x01;

/////// Set UART3 to XON and enable interrupt ///////////////////
	while(!U3TXIF) {}	// Wait or Tx interrupt flag set
	U3TXB = XON;		// Write data
	U3RXIE = 1;			// enable Receive interrupt
//	U3TXIE = 1;			// enable Trancemit interrupt
/////////////////////////////////////////////////////////////////

	GIE = 1;			// Global interrupt enable
	LATE1 = 1;			// BR = High
	LATE2 = 1;			// Release reset

	// 68030 start

	while(1){
		while(!CLC5OUT); 	// IO area
		ab.h = PORTD;		// Read address high
		ab.l = PORTB;		// Read address low

		if(!RA5) {						// Write cycle (RD inactive)
			if(ab.w == UART_DREG) {		// UART data register
				GIE = 0;				// Global interrupt disenable
				//////////////// Write Tx data form Tx buffer //////////////////
				if (tx_cnt < U3TB_SIZE) {
					tx_buf[tx_wp] = PORTC;
					tx_wp = (tx_wp + 1) & (U3TB_SIZE - 1);
					tx_cnt++;
					U3TXIE = 1;
				}
				////////////////////////////////////////////////////////////////
				GIE = 1;				// Global interrupt enable
//			} else {
//				LATE0 = 0;				// /BERR=Low
			}
			GIE = 0;			// Global interrupt disenable
#ifndef ASMBL
			// Release DSACK0 (D-FF reset)
			G3POL = 1;
			G3POL = 0;
#else
			asm(
			"movlb 0				\n"			// banked 0
			"bsf   CLCnPOL,2,b		\n"			// Release DSACK0 (D-FF reset)
			"bcf   CLCnPOL,2,b		\n"
			);
#endif
			GIE = 1;			// Global interrupt enable
		} else {
			TRISC = 0x00;					// Set data bus as output
			if(ab.w == UART_CREG){			// UART control register
				GIE = 0;					// Global interrupt disenable
				//////////////// UART3 buffer status ///////////////////////////
				LATC = (unsigned char)(((tx_cnt != U3TB_SIZE) << 1) | (rx_cnt != 0));
				////////////////////////////////////////////////////////////////
				GIE = 1;					// Global interrupt enable
			} else if(ab.w == UART_DREG){	// UART data register
				GIE = 0;					// Global interrupt disenable
				//////////////// Read Rx data form Rx buffer ///////////////////
				if (!rx_cnt) LATC = 0;
				else {
					LATC = rx_buf[rx_rp];
					rx_rp = (rx_rp + 1) & (U3RB_SIZE - 1);
					rx_cnt--;
					if ((rx_xflg == XOFF) && (rx_cnt == 10)) {
						rx_xreq = rx_xflg = XON;
						U3TXIE = 1;
					}
				}
				////////////////////////////////////////////////////////////////
				GIE = 1;					// Global interrupt enable
			} else {						// Out of memory
//				LATE0 = 0;					// /BERR=Low
				LATC = 0xff;				// Invalid data
			}
			GIE = 0;			// Global interrupt disenable
#ifndef ASMBL
			// Detect CLK falling edge
			while(RA2);
			// Release DSACK0 (D-FF reset)
			G3POL = 1;
			G3POL = 0;
			while(RA0);			// /AS
			TRISC = 0xff;		// Set as input
//			LATE0 = 1;			// /BERR=High
#else
			asm(
			"RA2_check:				\n"
			"btfsc PORTA,2,c		\n"			// Detect CLK falling edge
			"bra   RA2_check		\n"
			"movlb 0				\n"			// banked 0
			"bsf   CLCnPOL,2,b		\n"			// Release DSACK0 (D-FF reset)
			"bcf   CLCnPOL,2,b		\n"
			"RA0_check:				\n"
			"btfsc PORTA,0,c		\n"			// /AS
			"bra   RA0_check		\n"
			"setf  TRISC,c			\n"			// Set as input
			);
#endif
			GIE = 1;			// Global interrupt enable
		}
	}
}

const unsigned char rom[] = {
// Universal Monitor 68000
// 0x00000000-0x000000FF
	0x00, 0x01, 0xfe, 0x00, 0x00, 0x00, 0x00, 0xc0, 0x00, 0x01, 0xd7, 0xe4, 0x00, 0x01, 0xd7, 0xf8,
	0x00, 0x01, 0xd8, 0x0c, 0x00, 0x01, 0xd8, 0x98, 0x00, 0x01, 0xd8, 0xae, 0x00, 0x01, 0xd8, 0xc4,
	0x00, 0x01, 0xd8, 0xda, 0x00, 0x01, 0xd8, 0xf0, 0x00, 0x01, 0xd9, 0x06, 0x00, 0x01, 0xd9, 0x1c,
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	0xff, 0xff, 0xff, 0xff, 0xff, 0xff, 0xff, 0xff, 0xff, 0xff, 0xff, 0xff, 0xff, 0xff, 0xff, 0xff,
// 0x0001D000-0x0001E4FF
	0x20, 0x3c, 0x00, 0x00, 0x00, 0x01, 0x4e, 0x7b, 0x00, 0x02, 0x61, 0x00, 0x14, 0x0c, 0x20, 0x3c,
	0x00, 0x00, 0x00, 0xc0, 0x23, 0xc0, 0x00, 0x01, 0xfe, 0x18, 0x23, 0xc0, 0x00, 0x01, 0xfe, 0x22,
	0x23, 0xc0, 0x00, 0x01, 0xfe, 0x26, 0x13, 0xfc, 0x00, 0x53, 0x00, 0x01, 0xfe, 0x2a, 0x13, 0xfc,
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	0xff, 0xff, 0xff, 0xff, 0xff, 0xff, 0xff, 0xff, 0xff, 0xff, 0xff, 0xff, 0xff, 0xff, 0xff, 0xff
};