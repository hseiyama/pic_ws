;	HELLO - EMUZ80 HELLO, WORLD AND ECHO BACK
;	TARGET: EMUZ80
;	ASSEMBLER: ARCPIT XZ80.EXE
;
UARTDR	EQU	0E0H	; UART DATA REGISTOR
UARTCR	EQU	0E1H	; UART CONTROL REGISTOR
PORTDR	EQU	0D0H	; PORT DATA REGISTOR
ROMTOP	EQU	0000H	; ROM TOP
RAMTOP	EQU	3800H	; RAM TOP
RAMSIZ	EQU	800H	; RAM SIZE
STACK	EQU	(RAMTOP+RAMSIZ)
;
;	RESET
	ORG	ROMTOP
;
;	START
	LD	SP,STACK
	LD	HL,MESSAGE
HLLOOP:	LD	A,(HL)
	CP	00H
	JR	Z,EBLOOP
	CALL	PUTCH
	INC	HL
	JR	HLLOOP
;
EBLOOP:	IN	A,(PORTDR)
	OUT	(PORTDR),A
	CALL	GETCH
	CALL	PUTCH
	JR	EBLOOP
;
PUTCH:	PUSH	AF
PCST1:	IN	A,(UARTCR)
	BIT	1,A
	JR	Z,PCST1
	POP	AF
	OUT	(UARTDR),A
	RET
;
GETCH:	IN	A,(UARTCR)
	BIT	0,A
	JR	Z,GETCH
	IN	A,(UARTDR)
	RET
;
MESSAGE	DB	'HELLO, WORLD',0DH,0AH,0
;
	END
